SRAM_BASE = 0x20000000;
FLASH_BASE = 0x08000000;

MEMORY
{
	RAM (xrw) : ORIGIN = SRAM_BASE, LENGTH = SRAM_SIZE
	FLASH (rx) : ORIGIN = FLASH_BASE, LENGTH = FLASH_SIZE
}

EXTERN(__ARMv7_VECTORS);
ASSERT(DEFINED(__ARMv7_VECTORS), "Error: Core ISR vectors undefined.");
